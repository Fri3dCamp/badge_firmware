## boards/fox/sdkconfig.defaults
```kconfig
# !!!!!!!!!!!!!!!!!!!!!!!!!!!!!!!!!!!!!!!!!!!!!!!!!!!!!!!!!!!!!!!!!!!!!!!!!!!!!!!!!!!!!!!!!!!!!!!!!!!!!!!!!
# !!!                                                                                                   !!!
# !!!                         !!! DO NOT ADD LOCAL CONFIGURATION TO THIS FILE !!!                       !!!
# !!!                                                                                                   !!!
# !!!                                                                                                   !!!
# !!!   You can put testing configuration in `sdkconfig.local` and it will get picked up by `idf.py`.   !!!
# !!!   This file should only contain badge-specific configuration parameters!                          !!!
# !!!                                                                                                   !!!
# !!!   This helps prevent accidental commits of testing configuration to Git as `sdkconfig.local` is   !!!
# !!!   ignored in the .gitignore file.                                                                 !!!
# !!!                                                                                                   !!!
# !!!!!!!!!!!!!!!!!!!!!!!!!!!!!!!!!!!!!!!!!!!!!!!!!!!!!!!!!!!!!!!!!!!!!!!!!!!!!!!!!!!!!!!!!!!!!!!!!!!!!!!!!

# Platform configuration
CONFIG_IDF_TARGET="esp32s3"
CONFIG_FRI3D_BADGE_FOX=y
CONFIG_FRI3D_VERSIONS_URL="https://fri3d.be/firmware/firmware-fox.json"
```

## boards/octopus/sdkconfig.defaults
```kconfig
# !!!!!!!!!!!!!!!!!!!!!!!!!!!!!!!!!!!!!!!!!!!!!!!!!!!!!!!!!!!!!!!!!!!!!!!!!!!!!!!!!!!!!!!!!!!!!!!!!!!!!!!!!
# !!!                                                                                                   !!!
# !!!                         !!! DO NOT ADD LOCAL CONFIGURATION TO THIS FILE !!!                       !!!
# !!!                                                                                                   !!!
# !!!                                                                                                   !!!
# !!!   You can put testing configuration in `sdkconfig.local` and it will get picked up by `idf.py`.   !!!
# !!!   This file should only contain badge-specific configuration parameters!                          !!!
# !!!                                                                                                   !!!
# !!!   This helps prevent accidental commits of testing configuration to Git as `sdkconfig.local` is   !!!
# !!!   ignored in the .gitignore file.                                                                 !!!
# !!!                                                                                                   !!!
# !!!!!!!!!!!!!!!!!!!!!!!!!!!!!!!!!!!!!!!!!!!!!!!!!!!!!!!!!!!!!!!!!!!!!!!!!!!!!!!!!!!!!!!!!!!!!!!!!!!!!!!!!

# Platform configuration
CONFIG_IDF_TARGET="esp32"
CONFIG_FRI3D_BADGE_OCTOPUS=y
CONFIG_FRI3D_VERSIONS_URL="https://fri3d.be/firmware/v01/firmware-octopus.json"

# Temporary disable buzzer
CONFIG_FRI3D_BUZZER=n
```

## components/fri3d_application/Kconfig
```kconfig
menu "Fri3d Application"
    config FRI3D_DEFAULT_WIFI_SSID
        string "Default Wi-Fi SSID"
        default "fri3d-badge"
        help
            Set the default wifi SSID

    config FRI3D_DEFAULT_WIFI_PASSWORD
        string "Default Wi-Fi Password"
        default "badge2024"
        help
            Set the default wifi password

endmenu
```

## components/fri3d_bsp/Kconfig
```kconfig
menu "Fri3d Firmware"
    choice FRI3D_BADGE
        prompt "Fri3d Badge"
        default FRI3D_BADGE_FOX
        help
            Select the badge you are building the firmware for.

        config FRI3D_BADGE_FOX
            bool "Fox (2024)"

        config FRI3D_BADGE_OCTOPUS
            bool "Octopus (2022)"

    endchoice

    choice FRI3D_LOG
        prompt "Fri3d components debug level"
        default FRI3D_LOG_INFO
        help
            Increase the debug output level for Fri3d components

        config FRI3D_LOG_INFO
            bool "Info"

        config FRI3D_LOG_DEBUG
            bool "Debug"

        config FRI3D_LOG_VERBOSE
            bool "Verbose"

    endchoice

    config FRI3D_JOYSTICK
        bool "Use Joystick"
        default "n"
        help
            Specify fri3d_application should build ADC joystick code. The joystick has to be configured by the BSP.

    config FRI3D_ADC
        bool "Use ADC"
        default "n"
        help
            Specify fri3d_application should build ADC code. The ADC has to be configured by the BSP.

endmenu
```

## components/fri3d_ota/Kconfig
```kconfig
menu "Fri3d OTA"
    config FRI3D_VERSIONS_URL
        string "URL to fetch updates from"
        default ""

endmenu
```
